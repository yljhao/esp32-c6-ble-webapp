## tests/heartbeat/testcase.yaml
```yaml
tests:
  c6.heartbeat:
    tags:
      - c6
      - heartbeat
    platform_allow:
      - native_sim
      - native_sim/native/64
    integration_platforms:
      - native_sim/native/64
```

## tests/link_filter/testcase.yaml
```yaml
tests:
  c6.link_filter:
    tags:
      - c6
      - shell
    platform_allow:
      - native_sim
      - native_sim/native/64
    integration_platforms:
      - native_sim/native/64
```

## tests/nus_chunk/testcase.yaml
```yaml
tests:
  c6.nus_chunk:
    tags:
      - c6
      - ble
    platform_allow:
      - native_sim
      - native_sim/native/64
    integration_platforms:
      - native_sim/native/64
```
